#include "typeboy-advance.dtsi"

/ {
    &kscan0 {
        col-gpios
            = <&cart 0 GPIO_ACTIVE_HIGH>
            , <&cart 1 GPIO_ACTIVE_HIGH>
            , <&cart 2 GPIO_ACTIVE_HIGH>
            , <&cart 3 GPIO_ACTIVE_HIGH>
            , <&cart 4 GPIO_ACTIVE_HIGH>
            , <&cart 5 GPIO_ACTIVE_HIGH>
            ;
    };
};