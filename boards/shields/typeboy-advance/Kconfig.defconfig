## boards/shields/typeboy-advance/Kconfig.defconfig
```kconfig
if SHIELD_TYPEBOY_ADVANCE_LEFT

config ZMK_KEYBOARD_NAME
    default "TypeBoy Advance"

endif

if SHIELD_TYPEBOY_ADVANCE_LEFT || SHIELD_TYPEBOY_ADVANCE_RIGHT

config ZMK_SPLIT
    default y

config SPI
    default y

config ZMK_DISPLAY
	select LV_FONT_MONTSERRAT_28

config LS0XX
	default y
    
config ZMK_DISPLAY_INVERT
	default y

endif
```

## boards/shields/typeboy-advance/Kconfig.shield
```kconfig
config SHIELD_TYPEBOY_ADVANCE_LEFT
    def_bool $(shields_list_contains,typeboy-advance_left)

config SHIELD_TYPEBOY_ADVANCE_RIGHT
    def_bool $(shields_list_contains,typeboy-advance_right)
```

## boards/shields/typeboy-exp/Kconfig.defconfig
```kconfig
if SHIELD_TYPEBOY_EXP_LEFT

config ZMK_KEYBOARD_NAME
    default "TypeBoy Advance"

endif

if SHIELD_TYPEBOY_EXP_LEFT || SHIELD_TYPEBOY_EXP_RIGHT

config ZMK_SPLIT
    default y

config SPI
    default y

config ZMK_DISPLAY
	select LV_FONT_MONTSERRAT_28

config LS0XX
	default y
    
config ZMK_DISPLAY_INVERT
	default y

endif
```

## boards/shields/typeboy-exp/Kconfig.shield
```kconfig
config SHIELD_TYPEBOY_EXP_LEFT
    def_bool $(shields_list_contains,typeboy-exp_left)

config SHIELD_TYPEBOY_EXP_RIGHT
    def_bool $(shields_list_contains,typeboy-exp_right)
```
