#include "typeboy-advance.overlay"

&default_transform {
    col-offset = <6>;
};

&kscan0 {
    col-gpios
        = <&cart 5 GPIO_ACTIVE_HIGH>
        , <&cart 4 GPIO_ACTIVE_HIGH>
        , <&cart 3 GPIO_ACTIVE_HIGH>
        , <&cart 2 GPIO_ACTIVE_HIGH>
        , <&cart 1 GPIO_ACTIVE_HIGH>
        , <&cart 0 GPIO_ACTIVE_HIGH>
        ;
};