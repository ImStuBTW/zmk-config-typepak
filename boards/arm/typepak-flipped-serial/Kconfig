## boards/arm/typepak-flipped-serial/Kconfig
```kconfig
config BOARD_ENABLE_DCDC
    bool "Enable DCDC mode"
    select SOC_DCDC_NRF52X
    default y
    depends on (BOARD_TYPEPAK_FLIPPED_SERIAL)

config BOARD_TYPEPAK_FLIPPED_SERIAL_CHARGER
    bool "Enable battery charger"
    default y
    depends on (BOARD_TYPEPAK_FLIPPED_SERIAL)
```

## boards/arm/typepak-flipped-serial/Kconfig.board
```kconfig
config BOARD_TYPEPAK_FLIPPED_SERIAL
    bool "typepak-flipped-serial"
    depends on SOC_NRF52840_QIAA
```

## boards/arm/typepak-flipped-serial/Kconfig.defconfig
```kconfig
if BOARD_TYPEPAK_FLIPPED_SERIAL

config BOARD
    default "typepak-flipped-serial"

if USB_DEVICE_STACK

config USB_NRFX
    default y

endif # USB_DEVICE_STACK

config BT_CTLR
    default BT

config BOARD_TYPEPAK_FLIPPED_SERIAL_CHARGER
    default y

endif # BOARD_TYPEPAK_FLIPPED_SERIAL
```

## boards/shields/typeboy/Kconfig.defconfig
```kconfig
if SHIELD_TYPEBOY

config ZMK_KEYBOARD_NAME
    default "Type Boy 40"

onfig SPI
    default y

endif
```

## boards/shields/typeboy/Kconfig.shield
```kconfig
config SHIELD_TYPEBOY
    def_bool $(shields_list_contains,typeboy)

config ZMK_POINTING
    default y
```

## config/west.yml
```yaml
manifest:
  defaults:
    revision: v0.2
  remotes:
    - name: zmkfirmware
      url-base: https://github.com/zmkfirmware
    - name: Nicell
      url-base: https://github.com/Nicell
    - name: bortoz
      url-base: https://github.com/bortoz
    - name: cirque_trackpad
      url-base: https://github.com/petejohanson
  projects:
    - name: zmk
      remote: zmkfirmware
      import: app/west.yml
      revision: main
    - name: cirque-input-module
      revision: main
      remote: cirque_trackpad
  self:
    path: config
```
